## asic/librelane/chip/zephyr/module/Kconfig
```kconfig
# SPDX-License-Identifier: Apache-2.0

config I2C_WALLY
    bool "Wally I2C master (src/uncore/mcu/i2c_apb.sv)"
    default y
    depends on I2C && DT_HAS_WALLY_I2C_ENABLED
    select PINCTRL
    help
      Polled single-master driver for the chip's I2C controller.

config WDT_WALLY
    bool "Wally two-stage watchdog (src/uncore/mcu/wdt_apb.sv)"
    default y
    depends on WATCHDOG && DT_HAS_WALLY_WDT_ENABLED
    help
      Driver for the chip's watchdog: the first timeout is a flag, the second one resets the chip.

config COUNTER_WALLY
    bool "Wally timer as a counter, with capture (src/uncore/mcu/timer_apb.sv)"
    default y
    depends on COUNTER && DT_HAS_WALLY_TIMER_ENABLED
    select COUNTER_SUPPORTS_CAPTURE
    help
      Counter API on the chip's general-purpose timer: top value, four alarms and, with COUNTER_CAPTURE, edge capture
      on GPIO0-3.  The PWM API of the same timer is PWM_WALLY.

config PWM_WALLY
    bool "Wally timer as a PWM (src/uncore/mcu/timer_apb.sv)"
    default y
    depends on PWM && COUNTER_WALLY && DT_HAS_WALLY_TIMER_PWM_ENABLED
    select PINCTRL
    help
      PWM outputs on GPIO0-3, a child node of the timer.  Shares its counter and channels with COUNTER_WALLY.

config RTC_WALLY
    bool "Wally real-time counter (src/uncore/mcu/rtc_apb.sv)"
    default y
    depends on RTC && DT_HAS_WALLY_RTC_ENABLED
    help
      RTC API on the chip's real-time counter: seconds since 1970 and one alarm that matches a full date and time.
```

## asic/librelane/chip/zephyr/module/boards/openhwgroup/wally_chip/Kconfig.wally_chip
```kconfig
# SPDX-License-Identifier: Apache-2.0

config BOARD_WALLY_CHIP
        select SOC_WALLY_RV32IMAC
```

## asic/librelane/chip/zephyr/module/boards/openhwgroup/wally_chip/board.yml
```yaml
board:
  name: wally_chip
  full_name: CORE-V-Wally asic_soc_rv32imac
  vendor: openhwgroup
  socs:
    - name: wally_rv32imac
```

## asic/librelane/chip/zephyr/module/dts/bindings/counter/wally,timer.yaml
```yaml
description: |
  CORE-V-Wally general-purpose timer (src/uncore/mcu/timer_apb.sv): one 32-bit up counter with a 16-bit prescaler and
  an auto-reload (top) value, and four channels, each a compare (alarm or PWM output) or an input capture.  The
  channels' pads are GPIO0-3 (alternate function IOF1).  The PWM outputs are a child node (compatible
  "wally,timer-pwm"): the counter, its top value and the four channels are shared.

compatible: "wally,timer"

include: base.yaml

properties:
  reg:
    required: true

  interrupts:
    required: true

  clock-frequency:
    type: int
    required: true
    description: Frequency in Hz of the clock the prescaler divides

  prescaler:
    type: int
    default: 0
    description: The counter ticks once every prescaler+1 clocks (0 to 65535)
```

## asic/librelane/chip/zephyr/module/dts/bindings/gpio/wally,gpio.yaml
```yaml
description: |
  CORE-V-Wally GPIO (src/uncore/gpio_apb.sv), the register map of the SiFive FE310's.  Unlike the FE310 it has one
  interrupt line for the eight pins, not one per pin.

compatible: "wally,gpio"

include: [gpio-controller.yaml, base.yaml]

properties:
  reg:
    required: true

  interrupts:
    required: true

  "#gpio-cells":
    const: 2

gpio-cells:
  - pin
  - flags
```

## asic/librelane/chip/zephyr/module/dts/bindings/i2c/wally,i2c.yaml
```yaml
description: CORE-V-Wally I2C master (src/uncore/mcu/i2c_apb.sv)

compatible: "wally,i2c"

include: [i2c-controller.yaml, pinctrl-device.yaml]

properties:
  reg:
    required: true

  interrupts:
    description: |
      The controller's interrupt (PLIC source 17).  With it the driver sleeps while a command runs; without it,
      it polls.
```

## asic/librelane/chip/zephyr/module/dts/bindings/misc/wally,ai.yaml
```yaml
description: CORE-V-Wally int8 matrix-vector unit (src/uncore/ai/ai_unit.sv, chip asic_soc_rv32imac_ai)

compatible: "wally,ai"

include: base.yaml

properties:
  reg:
    required: true
```

## asic/librelane/chip/zephyr/module/dts/bindings/pwm/wally,timer-pwm.yaml
```yaml
description: |
  PWM outputs of the CORE-V-Wally timer, a child node of the timer (wally,timer): channel x drives GPIO x (IOF1),
  high while the counter is below the pulse.  The period is the timer's top value plus one, the same for the four
  channels, so it can only change while no other channel (alarm, capture or PWM) is in use.

compatible: "wally,timer-pwm"

include: [pwm-controller.yaml, pinctrl-device.yaml, base.yaml]

properties:
  "#pwm-cells":
    const: 3

pwm-cells:
  - channel
  - period
  - flags
```

## asic/librelane/chip/zephyr/module/dts/bindings/rtc/wally,rtc.yaml
```yaml
description: |
  CORE-V-Wally real-time counter (src/uncore/mcu/rtc_apb.sv): a 32-bit counter of seconds since 1970-01-01 with one
  alarm that matches all its fields (and ends a wfi).

compatible: "wally,rtc"

include: base.yaml

properties:
  reg:
    required: true

  interrupts:
    required: true

  clock-frequency:
    type: int
    required: true
    description: Frequency in Hz of the clock the divider counts

  tick-frequency:
    type: int
    default: 1
    description: |
      Ticks of the counter per second (1 for a real clock).  A simulation raises it to run the RTC faster than
      real time.
```

## asic/librelane/chip/zephyr/module/dts/bindings/watchdog/wally,wdt.yaml
```yaml
description: CORE-V-Wally two-stage watchdog (src/uncore/mcu/wdt_apb.sv)

compatible: "wally,wdt"

include: base.yaml

properties:
  reg:
    required: true

  clock-frequency:
    type: int
    required: true
    description: Frequency in Hz of the clock the watchdog's prescaler divides
```

## asic/librelane/chip/zephyr/module/soc/wally/Kconfig.soc
```kconfig
# SPDX-License-Identifier: Apache-2.0

config SOC_WALLY_RV32IMAC
        bool
        select RISCV
        select RISCV_PRIVILEGED
        select INCLUDE_RESET_VECTOR
        select RISCV_SOC_HAS_GP_RELATIVE_ADDRESSING
        help
          CORE-V-Wally RV32IMAC (Zaamo, Zalrsc, Zicntr, Zihpm) with Machine and User mode, 16 PMP entries, CLINT
          and PLIC: the chip of asic_soc_rv32imac.

config SOC
        default "wally_rv32imac" if SOC_WALLY_RV32IMAC
```
