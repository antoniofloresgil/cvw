/* chipsim: the testbench's UART runs at one bit every 16 clocks (divisor 1) */
&uart0 {
        current-speed = <1152000>;
};

/* chipsim: the RTC counts a thousand ticks per second, to see its seconds go by in a short simulation */
&rtc0 {
        tick-frequency = <1000>;
};
