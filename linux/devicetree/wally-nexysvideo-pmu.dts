/* Nexys Video with the optional PMU extensions (config fpganexysvideopmu): Sscofpmf, Smcntrpmf, Smcdeleg/Ssccfg. */
/include/ "wally-nexysvideo.dts"

/ {
  cpus {
    cpu@0 {
      riscv,isa-extensions = "i", "m", "a", "f", "d", "c", "sstc", "svade", "svadu", "svinval", "svnapot", "svpbmt", "zba", "zbb", "zbc", "zbs", "zca", "zcb", "zcd", "zfa", "zfh", "zkn", "zkt", "zicbom", "zicboz", "zicntr", "zicond", "zicsr", "zifencei", "zihpm", "sscofpmf", "smcntrpmf", "smcdeleg", "ssccfg", "sscsrind";
    };
  };
};
