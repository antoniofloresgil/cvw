// SPDX-License-Identifier: Apache-2.0 WITH SHL-2.1
// Generated by linux/pmu/events.py. Fixed-function event selectors: 0=off, nonzero=on.
// Requires the matching Wally RTL event table and COUNTERS configuration.
pmu {
    compatible = "riscv,pmu";
    riscv,event-to-mhpmcounters =
        <0x00001 0x00001 0x00000001> /* cycles */,
        <0x00002 0x00002 0x00000004> /* instructions */,
        <0x00003 0x00003 0x00002000> /* cache-references: L1D reads and writes */,
        <0x00004 0x00004 0x00004000> /* cache-misses: L1D reads and writes */,
        <0x00005 0x00005 0x02000000> /* branches: conditional branches, jumps and returns */,
        <0x00006 0x00006 0x04000000> /* branch-misses: mispredicted retired control transfers */,
        <0x10008 0x10008 0x00010000> /* L1-icache-loads */,
        <0x10009 0x10009 0x00020000> /* L1-icache-load-misses */;
    riscv,event-to-mhpmevent =
        <0x00003 0 1> /* cache-references: L1D reads and writes */,
        <0x00004 0 1> /* cache-misses: L1D reads and writes */,
        <0x00005 0 1> /* branches: conditional branches, jumps and returns */,
        <0x00006 0 1> /* branch-misses: mispredicted retired control transfers */,
        <0x10008 0 1> /* L1-icache-loads */,
        <0x10009 0 1> /* L1-icache-load-misses */;
    riscv,raw-event-to-mhpmcounters =
        <0 0x3 0xffffffff 0xffffffff 0x00000008>,
        <0 0x4 0xffffffff 0xffffffff 0x00000010>,
        <0 0x5 0xffffffff 0xffffffff 0x00000020>,
        <0 0x6 0xffffffff 0xffffffff 0x00000040>,
        <0 0x7 0xffffffff 0xffffffff 0x00000080>,
        <0 0x8 0xffffffff 0xffffffff 0x00000100>,
        <0 0x9 0xffffffff 0xffffffff 0x00000200>,
        <0 0xa 0xffffffff 0xffffffff 0x00000400>,
        <0 0xb 0xffffffff 0xffffffff 0x00000800>,
        <0 0xc 0xffffffff 0xffffffff 0x00001000>,
        <0 0xd 0xffffffff 0xffffffff 0x00002000>,
        <0 0xe 0xffffffff 0xffffffff 0x00004000>,
        <0 0xf 0xffffffff 0xffffffff 0x00008000>,
        <0 0x10 0xffffffff 0xffffffff 0x00010000>,
        <0 0x11 0xffffffff 0xffffffff 0x00020000>,
        <0 0x12 0xffffffff 0xffffffff 0x00040000>,
        <0 0x13 0xffffffff 0xffffffff 0x00080000>,
        <0 0x14 0xffffffff 0xffffffff 0x00100000>,
        <0 0x15 0xffffffff 0xffffffff 0x00200000>,
        <0 0x16 0xffffffff 0xffffffff 0x00400000>,
        <0 0x17 0xffffffff 0xffffffff 0x00800000>,
        <0 0x18 0xffffffff 0xffffffff 0x01000000>,
        <0 0x19 0xffffffff 0xffffffff 0x02000000>,
        <0 0x1a 0xffffffff 0xffffffff 0x04000000>;
};
